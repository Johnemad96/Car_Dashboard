## yocto/build-rpi/conf/bblayers.conf
```bitbake
# POKY_BBLAYERS_CONF_VERSION is increased each time build/conf/bblayers.conf
# changes incompatibly
POKY_BBLAYERS_CONF_VERSION = "2"

BBPATH = "${TOPDIR}"
BBFILES ?= ""

BBLAYERS ?= " \
  /home/john/personal_projects/Car_Dashboard/yocto/poky/meta \
  /home/john/personal_projects/Car_Dashboard/yocto/poky/meta-poky \
  /home/john/personal_projects/Car_Dashboard/yocto/poky/meta-yocto-bsp \
  /home/john/personal_projects/Car_Dashboard/yocto/meta-oe/meta-oe \
  /home/john/personal_projects/Car_Dashboard/yocto/meta-oe/meta-python \
  /home/john/personal_projects/Car_Dashboard/yocto/meta-oe/meta-networking \
  /home/john/personal_projects/Car_Dashboard/yocto/meta-rpi \
  /home/john/personal_projects/Car_Dashboard/yocto/car-dashboard \
  /home/john/personal_projects/Car_Dashboard/yocto/build-rpi/workspace \
  /home/john/personal_projects/Car_Dashboard/yocto/meta-ros/meta-ros-common \
  /home/john/personal_projects/Car_Dashboard/yocto/meta-ros/meta-ros2 \
  /home/john/personal_projects/Car_Dashboard/yocto/meta-ros/meta-ros2-humble \
  "
```
